## boards/qemu/cortex_a53/qemu_cortex_a53_qemu_cortex_a53_smp_defconfig
```kconfig
CONFIG_ARM_ARCH_TIMER=y

# Cache management
CONFIG_CACHE_MANAGEMENT=y

# Enable UART driver
CONFIG_SERIAL=y

# Enable console
CONFIG_CONSOLE=y
CONFIG_UART_CONSOLE=y

# Enable serial port
CONFIG_UART_INTERRUPT_DRIVEN=y

# icount does not work well with SMP
CONFIG_QEMU_ICOUNT=n

# We have multiple QEMU-A53 boards, so let us exercise ARMV8_A_NS on this one
# (plus it is needed for SMP)
CONFIG_ARMV8_A_NS=y

# PSCI is supported with NS
CONFIG_PM_CPU_OPS=y

# SMP-related
CONFIG_SMP=y
CONFIG_MP_MAX_NUM_CPUS=4
CONFIG_TIMEOUT_64BIT=y

#CONFIG_INIT_STACKS=y
#CONFIG_STACK_USAGE=y
#CONFIG_STACK_SENTINEL=y
#CONFIG_STACK_CANARIES=y
#CONFIG_EXTRA_EXCEPTION_INFO=y

#CONFIG_LTO=y
```

## boards/qemu/cortex_r5/qemu_cortex_r5_defconfig
```kconfig
CONFIG_XIP=n
CONFIG_QEMU_ICOUNT_SHIFT=3

CONFIG_ISR_STACK_SIZE=512
CONFIG_THREAD_STACK_INFO=y

# enable uart driver
CONFIG_SERIAL=y
#CONFIG_UART_INTERRUPT_DRIVEN=n

# enable console
CONFIG_CONSOLE=y
CONFIG_UART_CONSOLE=y

#CONFIG_SYS_CLOCK_TICKS_PER_SEC=100
CONFIG_ARM_MPU=y
#CONFIG_MPU_STACK_GUARD=y
#CONFIG_USERSPACE=y
#CONFIG_FPU=y
#CONFIG_FPU_SHARING=y

CONFIG_COMPILER_ISA_THUMB2=n

#CONFIG_EXTRA_EXCEPTION_INFO=y
#CONFIG_INIT_STACKS=y
#CONFIG_STACK_USAGE=y
#CONFIG_STACK_SENTINEL=y

#CONFIG_BOOT_BANNER=y

#CONFIG_MINIMAL_LIBC=y
#CONFIG_MINIMAL_LIBC_RAND=y
#CONFIG_NEWLIB_LIBC=y
#CONFIG_NEWLIB_LIBC_NANO=y
#CONFIG_PICOLIBC=y

#CONFIG_LTO=y
```
